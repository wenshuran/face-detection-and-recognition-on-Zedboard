/*
 * CAUTION: This file is automatically generated by Xilinx.
 * Version:  
 * Today is: Wed Apr 24 20:59:36 2019
*/


/dts-v1/;
/include/ "zynq-7000.dtsi"
/include/ "pl.dtsi"
/include/ "pcw.dtsi"
/ {
	chosen {
	};
	aliases {
	};
	memory {
		device_type = "memory";
		reg = <0x0 0x20000000>;
	};
};
